## app/build/Kconfig/soc/Kconfig.sysbuild.tmp
```kconfig
# Load Sysbuild SoC Kconfig descriptions.
osource "/Users/kostascaplinskas/miri-tl-inside-lift/zephyr/soc/xlnx/zynqmp/Kconfig.sysbuild"
osource "/Users/kostascaplinskas/miri-tl-inside-lift/zephyr/soc/xlnx/zynq7000/Kconfig.sysbuild"
osource "/Users/kostascaplinskas/miri-tl-inside-lift/zephyr/soc/xlnx/versalnet/Kconfig.sysbuild"
osource "/Users/kostascaplinskas/miri-tl-inside-lift/zephyr/soc/xlnx/versal2/Kconfig.sysbuild"
osource "/Users/kostascaplinskas/miri-tl-inside-lift/zephyr/soc/xlnx/versal/Kconfig.sysbuild"
osource "/Users/kostascaplinskas/miri-tl-inside-lift/zephyr/soc/xen/Kconfig.sysbuild"
osource "/Users/kostascaplinskas/miri-tl-inside-lift/zephyr/soc/wch/ch32v/Kconfig.sysbuild"
osource "/Users/kostascaplinskas/miri-tl-inside-lift/zephyr/soc/ti/simplelink/Kconfig.sysbuild"
osource "/Users/kostascaplinskas/miri-tl-inside-lift/zephyr/soc/ti/mspm0/Kconfig.sysbuild"
osource "/Users/kostascaplinskas/miri-tl-inside-lift/zephyr/soc/ti/lm3s6965/Kconfig.sysbuild"
osource "/Users/kostascaplinskas/miri-tl-inside-lift/zephyr/soc/ti/k3/Kconfig.sysbuild"
osource "/Users/kostascaplinskas/miri-tl-inside-lift/zephyr/soc/telink/tlsr/Kconfig.sysbuild"
osource "/Users/kostascaplinskas/miri-tl-inside-lift/zephyr/soc/starfive/jh71xx/Kconfig.sysbuild"
osource "/Users/kostascaplinskas/miri-tl-inside-lift/zephyr/soc/st/stm32/Kconfig.sysbuild"
osource "/Users/kostascaplinskas/miri-tl-inside-lift/zephyr/soc/snps/qemu_arc/Kconfig.sysbuild"
osource "/Users/kostascaplinskas/miri-tl-inside-lift/zephyr/soc/snps/nsim/arc_v/Kconfig.sysbuild"
osource "/Users/kostascaplinskas/miri-tl-inside-lift/zephyr/soc/snps/nsim/arc_classic/Kconfig.sysbuild"
osource "/Users/kostascaplinskas/miri-tl-inside-lift/zephyr/soc/snps/hsdk4xd/Kconfig.sysbuild"
osource "/Users/kostascaplinskas/miri-tl-inside-lift/zephyr/soc/snps/hsdk/Kconfig.sysbuild"
osource "/Users/kostascaplinskas/miri-tl-inside-lift/zephyr/soc/snps/emsk/Kconfig.sysbuild"
osource "/Users/kostascaplinskas/miri-tl-inside-lift/zephyr/soc/snps/emsdp/Kconfig.sysbuild"
osource "/Users/kostascaplinskas/miri-tl-inside-lift/zephyr/soc/snps/arc_iot/Kconfig.sysbuild"
osource "/Users/kostascaplinskas/miri-tl-inside-lift/zephyr/soc/silabs/Kconfig.sysbuild"
osource "/Users/kostascaplinskas/miri-tl-inside-lift/zephyr/soc/sifli/sf32/Kconfig.sysbuild"
osource "/Users/kostascaplinskas/miri-tl-inside-lift/zephyr/soc/sifive/sifive_freedom/Kconfig.sysbuild"
osource "/Users/kostascaplinskas/miri-tl-inside-lift/zephyr/soc/sensry/Kconfig.sysbuild"
osource "/Users/kostascaplinskas/miri-tl-inside-lift/zephyr/soc/rockchip/Kconfig.sysbuild"
osource "/Users/kostascaplinskas/miri-tl-inside-lift/zephyr/soc/renode/riscv_virtual/Kconfig.sysbuild"
osource "/Users/kostascaplinskas/miri-tl-inside-lift/zephyr/soc/renode/cortex_r8_virtual/Kconfig.sysbuild"
osource "/Users/kostascaplinskas/miri-tl-inside-lift/zephyr/soc/renesas/smartbond/Kconfig.sysbuild"
osource "/Users/kostascaplinskas/miri-tl-inside-lift/zephyr/soc/renesas/rz/Kconfig.sysbuild"
osource "/Users/kostascaplinskas/miri-tl-inside-lift/zephyr/soc/renesas/rx/Kconfig.sysbuild"
osource "/Users/kostascaplinskas/miri-tl-inside-lift/zephyr/soc/renesas/rcar/Kconfig.sysbuild"
osource "/Users/kostascaplinskas/miri-tl-inside-lift/zephyr/soc/renesas/ra/Kconfig.sysbuild"
osource "/Users/kostascaplinskas/miri-tl-inside-lift/zephyr/soc/realtek/fingerprint/Kconfig.sysbuild"
osource "/Users/kostascaplinskas/miri-tl-inside-lift/zephyr/soc/realtek/ec/Kconfig.sysbuild"
osource "/Users/kostascaplinskas/miri-tl-inside-lift/zephyr/soc/realtek/ameba/Kconfig.sysbuild"
osource "/Users/kostascaplinskas/miri-tl-inside-lift/zephyr/soc/raspberrypi/rpi_pico/Kconfig.sysbuild"
osource "/Users/kostascaplinskas/miri-tl-inside-lift/zephyr/soc/quicklogic/eos_s3/Kconfig.sysbuild"
osource "/Users/kostascaplinskas/miri-tl-inside-lift/zephyr/soc/qemu/virt_riscv/Kconfig.sysbuild"
osource "/Users/kostascaplinskas/miri-tl-inside-lift/zephyr/soc/qemu/malta/Kconfig.sysbuild"
osource "/Users/kostascaplinskas/miri-tl-inside-lift/zephyr/soc/openisa/rv32m1/Kconfig.sysbuild"
osource "/Users/kostascaplinskas/miri-tl-inside-lift/zephyr/soc/openhwgroup/cva6/Kconfig.sysbuild"
osource "/Users/kostascaplinskas/miri-tl-inside-lift/zephyr/soc/oct/osd32mp15x/Kconfig.sysbuild"
osource "/Users/kostascaplinskas/miri-tl-inside-lift/zephyr/soc/nxp/s32/Kconfig.sysbuild"
osource "/Users/kostascaplinskas/miri-tl-inside-lift/zephyr/soc/nxp/rw/Kconfig.sysbuild"
osource "/Users/kostascaplinskas/miri-tl-inside-lift/zephyr/soc/nxp/mcx/Kconfig.sysbuild"
osource "/Users/kostascaplinskas/miri-tl-inside-lift/zephyr/soc/nxp/lpc/Kconfig.sysbuild"
osource "/Users/kostascaplinskas/miri-tl-inside-lift/zephyr/soc/nxp/layerscape/Kconfig.sysbuild"
osource "/Users/kostascaplinskas/miri-tl-inside-lift/zephyr/soc/nxp/kinetis/Kconfig.sysbuild"
osource "/Users/kostascaplinskas/miri-tl-inside-lift/zephyr/soc/nxp/imxrt/Kconfig.sysbuild"
osource "/Users/kostascaplinskas/miri-tl-inside-lift/zephyr/soc/nxp/imx/Kconfig.sysbuild"
osource "/Users/kostascaplinskas/miri-tl-inside-lift/zephyr/soc/nuvoton/numicro/Kconfig.sysbuild"
osource "/Users/kostascaplinskas/miri-tl-inside-lift/zephyr/soc/nuvoton/numaker/Kconfig.sysbuild"
osource "/Users/kostascaplinskas/miri-tl-inside-lift/zephyr/soc/nuvoton/npcx/Kconfig.sysbuild"
osource "/Users/kostascaplinskas/miri-tl-inside-lift/zephyr/soc/nuvoton/npcm/Kconfig.sysbuild"
osource "/Users/kostascaplinskas/miri-tl-inside-lift/zephyr/soc/nordic/Kconfig.sysbuild"
osource "/Users/kostascaplinskas/miri-tl-inside-lift/zephyr/soc/neorv32/Kconfig.sysbuild"
osource "/Users/kostascaplinskas/miri-tl-inside-lift/zephyr/soc/native/inf_clock/Kconfig.sysbuild"
osource "/Users/kostascaplinskas/miri-tl-inside-lift/zephyr/soc/microchip/sam/sama7/Kconfig.sysbuild"
osource "/Users/kostascaplinskas/miri-tl-inside-lift/zephyr/soc/microchip/sam/sam_d5x_e5x/Kconfig.sysbuild"
osource "/Users/kostascaplinskas/miri-tl-inside-lift/zephyr/soc/microchip/pic64/Kconfig.sysbuild"
osource "/Users/kostascaplinskas/miri-tl-inside-lift/zephyr/soc/microchip/pic32c/pic32cz_ca/Kconfig.sysbuild"
osource "/Users/kostascaplinskas/miri-tl-inside-lift/zephyr/soc/microchip/pic32c/pic32cx_sg/Kconfig.sysbuild"
osource "/Users/kostascaplinskas/miri-tl-inside-lift/zephyr/soc/microchip/pic32c/pic32cm_pl/Kconfig.sysbuild"
osource "/Users/kostascaplinskas/miri-tl-inside-lift/zephyr/soc/microchip/pic32c/pic32cm_jh/Kconfig.sysbuild"
osource "/Users/kostascaplinskas/miri-tl-inside-lift/zephyr/soc/microchip/miv/Kconfig.sysbuild"
osource "/Users/kostascaplinskas/miri-tl-inside-lift/zephyr/soc/microchip/mec/Kconfig.sysbuild"
osource "/Users/kostascaplinskas/miri-tl-inside-lift/zephyr/soc/mediatek/mt8xxx/Kconfig.sysbuild"
osource "/Users/kostascaplinskas/miri-tl-inside-lift/zephyr/soc/lowrisc/opentitan/Kconfig.sysbuild"
osource "/Users/kostascaplinskas/miri-tl-inside-lift/zephyr/soc/litex/litex_vexriscv/Kconfig.sysbuild"
osource "/Users/kostascaplinskas/miri-tl-inside-lift/zephyr/soc/ite/ec/Kconfig.sysbuild"
osource "/Users/kostascaplinskas/miri-tl-inside-lift/zephyr/soc/intel/wildcat_lake/Kconfig.sysbuild"
osource "/Users/kostascaplinskas/miri-tl-inside-lift/zephyr/soc/intel/raptor_lake/Kconfig.sysbuild"
osource "/Users/kostascaplinskas/miri-tl-inside-lift/zephyr/soc/intel/panther_lake/Kconfig.sysbuild"
osource "/Users/kostascaplinskas/miri-tl-inside-lift/zephyr/soc/intel/lakemont/Kconfig.sysbuild"
osource "/Users/kostascaplinskas/miri-tl-inside-lift/zephyr/soc/intel/intel_socfpga_std/Kconfig.sysbuild"
osource "/Users/kostascaplinskas/miri-tl-inside-lift/zephyr/soc/intel/intel_socfpga/Kconfig.sysbuild"
osource "/Users/kostascaplinskas/miri-tl-inside-lift/zephyr/soc/intel/intel_niosv/Kconfig.sysbuild"
osource "/Users/kostascaplinskas/miri-tl-inside-lift/zephyr/soc/intel/intel_ish/Kconfig.sysbuild"
osource "/Users/kostascaplinskas/miri-tl-inside-lift/zephyr/soc/intel/intel_adsp/Kconfig.sysbuild"
osource "/Users/kostascaplinskas/miri-tl-inside-lift/zephyr/soc/intel/elkhart_lake/Kconfig.sysbuild"
osource "/Users/kostascaplinskas/miri-tl-inside-lift/zephyr/soc/intel/atom/Kconfig.sysbuild"
osource "/Users/kostascaplinskas/miri-tl-inside-lift/zephyr/soc/intel/apollo_lake/Kconfig.sysbuild"
osource "/Users/kostascaplinskas/miri-tl-inside-lift/zephyr/soc/intel/alder_lake/Kconfig.sysbuild"
osource "/Users/kostascaplinskas/miri-tl-inside-lift/zephyr/soc/infineon/psoc4/Kconfig.sysbuild"
osource "/Users/kostascaplinskas/miri-tl-inside-lift/zephyr/soc/infineon/edge/Kconfig.sysbuild"
osource "/Users/kostascaplinskas/miri-tl-inside-lift/zephyr/soc/infineon/cat3/Kconfig.sysbuild"
osource "/Users/kostascaplinskas/miri-tl-inside-lift/zephyr/soc/infineon/cat1c/Kconfig.sysbuild"
osource "/Users/kostascaplinskas/miri-tl-inside-lift/zephyr/soc/infineon/cat1b/Kconfig.sysbuild"
osource "/Users/kostascaplinskas/miri-tl-inside-lift/zephyr/soc/infineon/cat1a/Kconfig.sysbuild"
osource "/Users/kostascaplinskas/miri-tl-inside-lift/zephyr/soc/gd/gd32/Kconfig.sysbuild"
osource "/Users/kostascaplinskas/miri-tl-inside-lift/zephyr/soc/gaisler/leon3/Kconfig.sysbuild"
osource "/Users/kostascaplinskas/miri-tl-inside-lift/zephyr/soc/gaisler/gr716a/Kconfig.sysbuild"
osource "/Users/kostascaplinskas/miri-tl-inside-lift/zephyr/soc/focaltech/Kconfig.sysbuild"
osource "/Users/kostascaplinskas/miri-tl-inside-lift/zephyr/soc/espressif/Kconfig.sysbuild"
osource "/Users/kostascaplinskas/miri-tl-inside-lift/zephyr/soc/ene/kb1200/Kconfig.sysbuild"
osource "/Users/kostascaplinskas/miri-tl-inside-lift/zephyr/soc/ene/kb106x/Kconfig.sysbuild"
osource "/Users/kostascaplinskas/miri-tl-inside-lift/zephyr/soc/elan/em32f967/Kconfig.sysbuild"
osource "/Users/kostascaplinskas/miri-tl-inside-lift/zephyr/soc/egis/Kconfig.sysbuild"
osource "/Users/kostascaplinskas/miri-tl-inside-lift/zephyr/soc/efinix/sapphire/Kconfig.sysbuild"
osource "/Users/kostascaplinskas/miri-tl-inside-lift/zephyr/soc/cdns/xtensa_sample_controller/Kconfig.sysbuild"
osource "/Users/kostascaplinskas/miri-tl-inside-lift/zephyr/soc/cdns/sample_controller32/Kconfig.sysbuild"
osource "/Users/kostascaplinskas/miri-tl-inside-lift/zephyr/soc/cdns/dc233c/Kconfig.sysbuild"
osource "/Users/kostascaplinskas/miri-tl-inside-lift/zephyr/soc/brcm/bcmvk/Kconfig.sysbuild"
osource "/Users/kostascaplinskas/miri-tl-inside-lift/zephyr/soc/brcm/bcm2712/Kconfig.sysbuild"
osource "/Users/kostascaplinskas/miri-tl-inside-lift/zephyr/soc/brcm/bcm2711/Kconfig.sysbuild"
osource "/Users/kostascaplinskas/miri-tl-inside-lift/zephyr/soc/blackberry/qnxhv_vm/Kconfig.sysbuild"
osource "/Users/kostascaplinskas/miri-tl-inside-lift/zephyr/soc/bflb/Kconfig.sysbuild"
osource "/Users/kostascaplinskas/miri-tl-inside-lift/zephyr/soc/atmel/sam0/Kconfig.sysbuild"
osource "/Users/kostascaplinskas/miri-tl-inside-lift/zephyr/soc/atmel/sam/Kconfig.sysbuild"
osource "/Users/kostascaplinskas/miri-tl-inside-lift/zephyr/soc/aspeed/Kconfig.sysbuild"
osource "/Users/kostascaplinskas/miri-tl-inside-lift/zephyr/soc/arm/Kconfig.sysbuild"
osource "/Users/kostascaplinskas/miri-tl-inside-lift/zephyr/soc/arm/beetle/Kconfig.sysbuild"
osource "/Users/kostascaplinskas/miri-tl-inside-lift/zephyr/soc/antmicro/myra/Kconfig.sysbuild"
osource "/Users/kostascaplinskas/miri-tl-inside-lift/zephyr/soc/andestech/Kconfig.sysbuild"
osource "/Users/kostascaplinskas/miri-tl-inside-lift/zephyr/soc/amd/acp_6_0/Kconfig.sysbuild"
osource "/Users/kostascaplinskas/miri-tl-inside-lift/zephyr/soc/ambiq/Kconfig.sysbuild"
osource "/Users/kostascaplinskas/miri-tl-inside-lift/zephyr/soc/allwinner/sun8i_h3/Kconfig.sysbuild"
osource "/Users/kostascaplinskas/miri-tl-inside-lift/zephyr/soc/aesc/Kconfig.sysbuild"
osource "/Users/kostascaplinskas/miri-tl-inside-lift/zephyr/soc/adi/max32/Kconfig.sysbuild"
```

## esd/sample.yaml
```yaml
# This file is provided so that the application can be compiled using Twister,
# the Zephyr testing tool. In this file, multiple combinations can be specified,
# so that you can easily test all of them locally or in CI.
sample:
  description: PCB application without heater outputs
  name: pcb-application
common:
  build_only: true
  integration_platforms:
    - nucleo_l432kc
tests:
  app.default: {}
  app.debug:
    extra_overlay_confs:
      - debug.conf
```
