## app/build/Kconfig/arch/Kconfig
```kconfig
# Load Zephyr Arch Kconfig descriptions.
osource "C:/Users/kostas.caplinskas/Documents/zephyrproject/zephyr/arch/rx/Kconfig"
osource "C:/Users/kostas.caplinskas/Documents/zephyrproject/zephyr/arch/x86/Kconfig"
osource "C:/Users/kostas.caplinskas/Documents/zephyrproject/zephyr/arch/xtensa/Kconfig"
osource "C:/Users/kostas.caplinskas/Documents/zephyrproject/zephyr/arch/sparc/Kconfig"
osource "C:/Users/kostas.caplinskas/Documents/zephyrproject/zephyr/arch/riscv/Kconfig"
osource "C:/Users/kostas.caplinskas/Documents/zephyrproject/zephyr/arch/posix/Kconfig"
osource "C:/Users/kostas.caplinskas/Documents/zephyrproject/zephyr/arch/mips/Kconfig"
osource "C:/Users/kostas.caplinskas/Documents/zephyrproject/zephyr/arch/arm64/Kconfig"
osource "C:/Users/kostas.caplinskas/Documents/zephyrproject/zephyr/arch/arm/Kconfig"
osource "C:/Users/kostas.caplinskas/Documents/zephyrproject/zephyr/arch/arc/Kconfig"
```

## app/build/Kconfig/boards/Kconfig
```kconfig
# Load Zephyr board Kconfig descriptions.
osource "/Users/kostascaplinskas/miri-tl-inside-lift/zephyr/boards/st/nucleo_l073rz/Kconfig"
```

## app/build/Kconfig/boards/Kconfig.defconfig
```kconfig
# Load Zephyr board defconfig descriptions.
osource "/Users/kostascaplinskas/miri-tl-inside-lift/zephyr/boards/st/nucleo_l073rz/Kconfig.defconfig"
```

## app/build/Kconfig/boards/Kconfig.defconfig.tmp
```kconfig
# Load Zephyr board defconfig descriptions.
osource "C:/Users/kostas.caplinskas/Documents/zephyrproject/zephyr/boards/st/nucleo_l432kc/Kconfig.defconfig"
```

## app/build/Kconfig/boards/Kconfig.nucleo_l073rz
```kconfig
# Load board Kconfig descriptions.
osource "/Users/kostascaplinskas/miri-tl-inside-lift/zephyr/boards/st/nucleo_l073rz/Kconfig.nucleo_l073rz"
```

## app/build/Kconfig/boards/Kconfig.sysbuild
```kconfig
# Load Sysbuild board Kconfig descriptions.
osource "C:/Users/kostas.caplinskas/Documents/zephyrproject/zephyr/boards/st/nucleo_l073rz/Kconfig.sysbuild"
```

## app/build/Kconfig/boards/Kconfig.tmp
```kconfig
# Load Zephyr board Kconfig descriptions.
osource "C:/Users/kostas.caplinskas/Documents/zephyrproject/zephyr/boards/st/nucleo_l452re/Kconfig"
```

## app/build/Kconfig/soc/Kconfig
```kconfig
# Load Zephyr SoC Kconfig descriptions.
osource "/Users/kostascaplinskas/miri-tl-inside-lift/zephyr/soc/xlnx/zynqmp/Kconfig"
osource "/Users/kostascaplinskas/miri-tl-inside-lift/zephyr/soc/xlnx/zynq7000/Kconfig"
osource "/Users/kostascaplinskas/miri-tl-inside-lift/zephyr/soc/xlnx/versalnet/Kconfig"
osource "/Users/kostascaplinskas/miri-tl-inside-lift/zephyr/soc/xlnx/versal2/Kconfig"
osource "/Users/kostascaplinskas/miri-tl-inside-lift/zephyr/soc/xlnx/versal/Kconfig"
osource "/Users/kostascaplinskas/miri-tl-inside-lift/zephyr/soc/xen/Kconfig"
osource "/Users/kostascaplinskas/miri-tl-inside-lift/zephyr/soc/wch/ch32v/Kconfig"
osource "/Users/kostascaplinskas/miri-tl-inside-lift/zephyr/soc/ti/simplelink/Kconfig"
osource "/Users/kostascaplinskas/miri-tl-inside-lift/zephyr/soc/ti/mspm0/Kconfig"
osource "/Users/kostascaplinskas/miri-tl-inside-lift/zephyr/soc/ti/lm3s6965/Kconfig"
osource "/Users/kostascaplinskas/miri-tl-inside-lift/zephyr/soc/ti/k3/Kconfig"
osource "/Users/kostascaplinskas/miri-tl-inside-lift/zephyr/soc/telink/tlsr/Kconfig"
osource "/Users/kostascaplinskas/miri-tl-inside-lift/zephyr/soc/starfive/jh71xx/Kconfig"
osource "/Users/kostascaplinskas/miri-tl-inside-lift/zephyr/soc/st/stm32/Kconfig"
osource "/Users/kostascaplinskas/miri-tl-inside-lift/zephyr/soc/snps/qemu_arc/Kconfig"
osource "/Users/kostascaplinskas/miri-tl-inside-lift/zephyr/soc/snps/nsim/arc_v/Kconfig"
osource "/Users/kostascaplinskas/miri-tl-inside-lift/zephyr/soc/snps/nsim/arc_classic/Kconfig"
osource "/Users/kostascaplinskas/miri-tl-inside-lift/zephyr/soc/snps/hsdk4xd/Kconfig"
osource "/Users/kostascaplinskas/miri-tl-inside-lift/zephyr/soc/snps/hsdk/Kconfig"
osource "/Users/kostascaplinskas/miri-tl-inside-lift/zephyr/soc/snps/emsk/Kconfig"
osource "/Users/kostascaplinskas/miri-tl-inside-lift/zephyr/soc/snps/emsdp/Kconfig"
osource "/Users/kostascaplinskas/miri-tl-inside-lift/zephyr/soc/snps/arc_iot/Kconfig"
osource "/Users/kostascaplinskas/miri-tl-inside-lift/zephyr/soc/silabs/Kconfig"
osource "/Users/kostascaplinskas/miri-tl-inside-lift/zephyr/soc/sifli/sf32/Kconfig"
osource "/Users/kostascaplinskas/miri-tl-inside-lift/zephyr/soc/sifive/sifive_freedom/Kconfig"
osource "/Users/kostascaplinskas/miri-tl-inside-lift/zephyr/soc/sensry/Kconfig"
osource "/Users/kostascaplinskas/miri-tl-inside-lift/zephyr/soc/rockchip/Kconfig"
osource "/Users/kostascaplinskas/miri-tl-inside-lift/zephyr/soc/renode/riscv_virtual/Kconfig"
osource "/Users/kostascaplinskas/miri-tl-inside-lift/zephyr/soc/renode/cortex_r8_virtual/Kconfig"
osource "/Users/kostascaplinskas/miri-tl-inside-lift/zephyr/soc/renesas/smartbond/Kconfig"
osource "/Users/kostascaplinskas/miri-tl-inside-lift/zephyr/soc/renesas/rz/Kconfig"
osource "/Users/kostascaplinskas/miri-tl-inside-lift/zephyr/soc/renesas/rx/Kconfig"
osource "/Users/kostascaplinskas/miri-tl-inside-lift/zephyr/soc/renesas/rcar/Kconfig"
osource "/Users/kostascaplinskas/miri-tl-inside-lift/zephyr/soc/renesas/ra/Kconfig"
osource "/Users/kostascaplinskas/miri-tl-inside-lift/zephyr/soc/realtek/fingerprint/Kconfig"
osource "/Users/kostascaplinskas/miri-tl-inside-lift/zephyr/soc/realtek/ec/Kconfig"
osource "/Users/kostascaplinskas/miri-tl-inside-lift/zephyr/soc/realtek/ameba/Kconfig"
osource "/Users/kostascaplinskas/miri-tl-inside-lift/zephyr/soc/raspberrypi/rpi_pico/Kconfig"
osource "/Users/kostascaplinskas/miri-tl-inside-lift/zephyr/soc/quicklogic/eos_s3/Kconfig"
osource "/Users/kostascaplinskas/miri-tl-inside-lift/zephyr/soc/qemu/virt_riscv/Kconfig"
osource "/Users/kostascaplinskas/miri-tl-inside-lift/zephyr/soc/qemu/malta/Kconfig"
osource "/Users/kostascaplinskas/miri-tl-inside-lift/zephyr/soc/openisa/rv32m1/Kconfig"
osource "/Users/kostascaplinskas/miri-tl-inside-lift/zephyr/soc/openhwgroup/cva6/Kconfig"
osource "/Users/kostascaplinskas/miri-tl-inside-lift/zephyr/soc/oct/osd32mp15x/Kconfig"
osource "/Users/kostascaplinskas/miri-tl-inside-lift/zephyr/soc/nxp/s32/Kconfig"
osource "/Users/kostascaplinskas/miri-tl-inside-lift/zephyr/soc/nxp/rw/Kconfig"
osource "/Users/kostascaplinskas/miri-tl-inside-lift/zephyr/soc/nxp/mcx/Kconfig"
osource "/Users/kostascaplinskas/miri-tl-inside-lift/zephyr/soc/nxp/lpc/Kconfig"
osource "/Users/kostascaplinskas/miri-tl-inside-lift/zephyr/soc/nxp/layerscape/Kconfig"
osource "/Users/kostascaplinskas/miri-tl-inside-lift/zephyr/soc/nxp/kinetis/Kconfig"
osource "/Users/kostascaplinskas/miri-tl-inside-lift/zephyr/soc/nxp/imxrt/Kconfig"
osource "/Users/kostascaplinskas/miri-tl-inside-lift/zephyr/soc/nxp/imx/Kconfig"
osource "/Users/kostascaplinskas/miri-tl-inside-lift/zephyr/soc/nuvoton/numicro/Kconfig"
osource "/Users/kostascaplinskas/miri-tl-inside-lift/zephyr/soc/nuvoton/numaker/Kconfig"
osource "/Users/kostascaplinskas/miri-tl-inside-lift/zephyr/soc/nuvoton/npcx/Kconfig"
osource "/Users/kostascaplinskas/miri-tl-inside-lift/zephyr/soc/nuvoton/npcm/Kconfig"
osource "/Users/kostascaplinskas/miri-tl-inside-lift/zephyr/soc/nordic/Kconfig"
osource "/Users/kostascaplinskas/miri-tl-inside-lift/zephyr/soc/neorv32/Kconfig"
osource "/Users/kostascaplinskas/miri-tl-inside-lift/zephyr/soc/native/inf_clock/Kconfig"
osource "/Users/kostascaplinskas/miri-tl-inside-lift/zephyr/soc/microchip/sam/sama7/Kconfig"
osource "/Users/kostascaplinskas/miri-tl-inside-lift/zephyr/soc/microchip/sam/sam_d5x_e5x/Kconfig"
osource "/Users/kostascaplinskas/miri-tl-inside-lift/zephyr/soc/microchip/pic64/Kconfig"
osource "/Users/kostascaplinskas/miri-tl-inside-lift/zephyr/soc/microchip/pic32c/pic32cz_ca/Kconfig"
osource "/Users/kostascaplinskas/miri-tl-inside-lift/zephyr/soc/microchip/pic32c/pic32cx_sg/Kconfig"
osource "/Users/kostascaplinskas/miri-tl-inside-lift/zephyr/soc/microchip/pic32c/pic32cm_pl/Kconfig"
osource "/Users/kostascaplinskas/miri-tl-inside-lift/zephyr/soc/microchip/pic32c/pic32cm_jh/Kconfig"
osource "/Users/kostascaplinskas/miri-tl-inside-lift/zephyr/soc/microchip/miv/Kconfig"
osource "/Users/kostascaplinskas/miri-tl-inside-lift/zephyr/soc/microchip/mec/Kconfig"
osource "/Users/kostascaplinskas/miri-tl-inside-lift/zephyr/soc/mediatek/mt8xxx/Kconfig"
osource "/Users/kostascaplinskas/miri-tl-inside-lift/zephyr/soc/lowrisc/opentitan/Kconfig"
osource "/Users/kostascaplinskas/miri-tl-inside-lift/zephyr/soc/litex/litex_vexriscv/Kconfig"
osource "/Users/kostascaplinskas/miri-tl-inside-lift/zephyr/soc/ite/ec/Kconfig"
osource "/Users/kostascaplinskas/miri-tl-inside-lift/zephyr/soc/intel/wildcat_lake/Kconfig"
osource "/Users/kostascaplinskas/miri-tl-inside-lift/zephyr/soc/intel/raptor_lake/Kconfig"
osource "/Users/kostascaplinskas/miri-tl-inside-lift/zephyr/soc/intel/panther_lake/Kconfig"
osource "/Users/kostascaplinskas/miri-tl-inside-lift/zephyr/soc/intel/lakemont/Kconfig"
osource "/Users/kostascaplinskas/miri-tl-inside-lift/zephyr/soc/intel/intel_socfpga_std/Kconfig"
osource "/Users/kostascaplinskas/miri-tl-inside-lift/zephyr/soc/intel/intel_socfpga/Kconfig"
osource "/Users/kostascaplinskas/miri-tl-inside-lift/zephyr/soc/intel/intel_niosv/Kconfig"
osource "/Users/kostascaplinskas/miri-tl-inside-lift/zephyr/soc/intel/intel_ish/Kconfig"
osource "/Users/kostascaplinskas/miri-tl-inside-lift/zephyr/soc/intel/intel_adsp/Kconfig"
osource "/Users/kostascaplinskas/miri-tl-inside-lift/zephyr/soc/intel/elkhart_lake/Kconfig"
osource "/Users/kostascaplinskas/miri-tl-inside-lift/zephyr/soc/intel/atom/Kconfig"
osource "/Users/kostascaplinskas/miri-tl-inside-lift/zephyr/soc/intel/apollo_lake/Kconfig"
osource "/Users/kostascaplinskas/miri-tl-inside-lift/zephyr/soc/intel/alder_lake/Kconfig"
osource "/Users/kostascaplinskas/miri-tl-inside-lift/zephyr/soc/infineon/psoc4/Kconfig"
osource "/Users/kostascaplinskas/miri-tl-inside-lift/zephyr/soc/infineon/edge/Kconfig"
osource "/Users/kostascaplinskas/miri-tl-inside-lift/zephyr/soc/infineon/cat3/Kconfig"
osource "/Users/kostascaplinskas/miri-tl-inside-lift/zephyr/soc/infineon/cat1c/Kconfig"
osource "/Users/kostascaplinskas/miri-tl-inside-lift/zephyr/soc/infineon/cat1b/Kconfig"
osource "/Users/kostascaplinskas/miri-tl-inside-lift/zephyr/soc/infineon/cat1a/Kconfig"
osource "/Users/kostascaplinskas/miri-tl-inside-lift/zephyr/soc/gd/gd32/Kconfig"
osource "/Users/kostascaplinskas/miri-tl-inside-lift/zephyr/soc/gaisler/leon3/Kconfig"
osource "/Users/kostascaplinskas/miri-tl-inside-lift/zephyr/soc/gaisler/gr716a/Kconfig"
osource "/Users/kostascaplinskas/miri-tl-inside-lift/zephyr/soc/focaltech/Kconfig"
osource "/Users/kostascaplinskas/miri-tl-inside-lift/zephyr/soc/espressif/Kconfig"
osource "/Users/kostascaplinskas/miri-tl-inside-lift/zephyr/soc/ene/kb1200/Kconfig"
osource "/Users/kostascaplinskas/miri-tl-inside-lift/zephyr/soc/ene/kb106x/Kconfig"
osource "/Users/kostascaplinskas/miri-tl-inside-lift/zephyr/soc/elan/em32f967/Kconfig"
osource "/Users/kostascaplinskas/miri-tl-inside-lift/zephyr/soc/egis/Kconfig"
osource "/Users/kostascaplinskas/miri-tl-inside-lift/zephyr/soc/efinix/sapphire/Kconfig"
osource "/Users/kostascaplinskas/miri-tl-inside-lift/zephyr/soc/cdns/xtensa_sample_controller/Kconfig"
osource "/Users/kostascaplinskas/miri-tl-inside-lift/zephyr/soc/cdns/sample_controller32/Kconfig"
osource "/Users/kostascaplinskas/miri-tl-inside-lift/zephyr/soc/cdns/dc233c/Kconfig"
osource "/Users/kostascaplinskas/miri-tl-inside-lift/zephyr/soc/brcm/bcmvk/Kconfig"
osource "/Users/kostascaplinskas/miri-tl-inside-lift/zephyr/soc/brcm/bcm2712/Kconfig"
osource "/Users/kostascaplinskas/miri-tl-inside-lift/zephyr/soc/brcm/bcm2711/Kconfig"
osource "/Users/kostascaplinskas/miri-tl-inside-lift/zephyr/soc/blackberry/qnxhv_vm/Kconfig"
osource "/Users/kostascaplinskas/miri-tl-inside-lift/zephyr/soc/bflb/Kconfig"
osource "/Users/kostascaplinskas/miri-tl-inside-lift/zephyr/soc/atmel/sam0/Kconfig"
osource "/Users/kostascaplinskas/miri-tl-inside-lift/zephyr/soc/atmel/sam/Kconfig"
osource "/Users/kostascaplinskas/miri-tl-inside-lift/zephyr/soc/aspeed/Kconfig"
osource "/Users/kostascaplinskas/miri-tl-inside-lift/zephyr/soc/arm/Kconfig"
osource "/Users/kostascaplinskas/miri-tl-inside-lift/zephyr/soc/arm/beetle/Kconfig"
osource "/Users/kostascaplinskas/miri-tl-inside-lift/zephyr/soc/antmicro/myra/Kconfig"
osource "/Users/kostascaplinskas/miri-tl-inside-lift/zephyr/soc/andestech/Kconfig"
osource "/Users/kostascaplinskas/miri-tl-inside-lift/zephyr/soc/amd/acp_6_0/Kconfig"
osource "/Users/kostascaplinskas/miri-tl-inside-lift/zephyr/soc/ambiq/Kconfig"
osource "/Users/kostascaplinskas/miri-tl-inside-lift/zephyr/soc/allwinner/sun8i_h3/Kconfig"
osource "/Users/kostascaplinskas/miri-tl-inside-lift/zephyr/soc/aesc/Kconfig"
osource "/Users/kostascaplinskas/miri-tl-inside-lift/zephyr/soc/adi/max32/Kconfig"
```
